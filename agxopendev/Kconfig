## agxopendev/Kconfig
```kconfig
config AGXOPEN_RTBUDDY
	tristate "Apple M4 AGX GPU RTBuddy support"
	depends on ARCH_APPLE || COMPILE_TEST
	help
	  Enable RTBuddy based coprocessor communication for the Apple M4
	  AGX GPU found on Mac16 class hardware. This provides the mailbox
	  transport, the RTKit management handshake and the system endpoint
	  bring up needed before the GPU firmware can be driven by the rest
	  of the graphics driver stack.

	  This module talks to the coprocessor mailbox directly and does not
	  depend on the generic apple rtkit subsystem, since the M4 variant
	  maps its mailbox into the same register block as the coprocessor
	  control registers rather than as a separate device.
```
